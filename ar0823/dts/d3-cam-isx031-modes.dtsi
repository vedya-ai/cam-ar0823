/*
 * Copyright (c) 2023-2024, Define Design Deploy Corp. All rights reserved.
 *
 * This program is free software; you can redistribute it and/or modify
 * it under the terms of the GNU General Public License as published by
 * the Free Software Foundation; version 2 of the License.
 *
 * This program is distributed in the hope that it will be useful, but WITHOUT
 * ANY WARRANTY; without even the implied warranty of MERCHANTABILITY or
 * FITNESS FOR A PARTICULAR PURPOSE.  See the GNU General Public License for
 * more details.
 */

/* The gain factor is set such that the minimum step size 1/(2^7) = 0.0078125 can be represented fully.
 * The min value is defined as 1.684 per the datasheet, and maximum is 16 per
 * Nvidia conformance tests (and sanity).
 */
#define COMMON_GAIN				\
	gain_factor =    "10000000";		\
	step_gain_val =     "78125";		\
	min_gain_val =   "16842100";		\
	max_gain_val =   "91428600";		\
	default_gain =   "16842100";

// Note: These exposure and gain values are not used since the ISX031 outputs
// processed image data. They are copied from the AR0234 driver to appease
// NVIDIA's various drivers, but are not used for anything.
#define COMMON_EXPOSURE							\
	exposure_factor = "1000000"; /* 1us per count */		\
	step_exp_time =         "1"; /* fine integration time has 1-clk resolution */ \
	min_exp_time =         "11"; /* min coarse integration is 2 counts (~2 lines) */ \
	default_exp_time =     "11";			\
	max_exp_time = "32476";

#define ISX031_COMMON					\
	mclk_khz = "25000";				\
	mclk_multiplier = "4";				\
	num_lanes = STR(CSI_LANES);			\
	tegra_sinterface = STR(TEGRA_SINTERFACE);	\
	lane_polarity = STR(LANE_POLARITY);		\
	discontinuous_clk = "no";			\
	dpcm_enable = "false";				\
	cil_settletime = "0";				\
	csi_pixel_bit_depth = "16";			\
	mode_type = "yuv";				\
	pixel_phase = "uyvy";				\
	readout_orientation = "0";			\
	inherent_gain = "1";				\
	serdes_pix_clk_hz = STR(SERDES_PIX_CLK_HZ);	\
	embedded_metadata_height = "0"; /* Metadata always disabled */ \
	vc_id = STR(PORT_VCID);				\
	phy_mode = "DPHY";				\
	COMMON_EXPOSURE					\
	COMMON_GAIN					\
	framerate_factor = "1";				\
	step_framerate = "1";				\
	min_hdr_ratio = "1";				\
	max_hdr_ratio = "1";				\
	num_control_points = "0";


mode0 {
	/* 30fps 4 lanes */
	ISX031_COMMON

	active_w = "1920";
	active_h = "1536";

	// 2200 * 1750 * 30
	pix_clk_hz = "115500000";
	line_length = "1920";

	min_framerate = "30";
	default_framerate = "30";
	max_framerate = "30";
};

mode1 {
	/* 30fps 4 lanes cropped */
	ISX031_COMMON

	active_w = "1600";
	active_h = "1280";

	// 2200 * 1750 * 30
	pix_clk_hz = "115500000";
	line_length = "1600";

	min_framerate = "30";
	default_framerate = "30";
	max_framerate = "30";
};

#undef COMMON_EXPOSURE
#undef COMMON_GAIN
#undef ISX031_COMMON
