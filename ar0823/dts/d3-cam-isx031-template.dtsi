/*
 * Copyright (c) 2023-2024, Define Design Deploy Corp. All rights reserved.
 *
 * This program is free software; you can redistribute it and/or modify
 * it under the terms of the GNU General Public License as published by
 * the Free Software Foundation; version 2 of the License.
 *
 * This program is distributed in the hope that it will be useful, but WITHOUT
 * ANY WARRANTY; without even the implied warranty of MERCHANTABILITY or
 * FITNESS FOR A PARTICULAR PURPOSE.  See the GNU General Public License for
 * more details.
*/

#include <dt-bindings/gpio/gpio.h>
#include <d3/d3-naming-utils.dtsi>

#define IMG_ADDR_PHYSICAL 1a
#if HEX_PREFIX(IMG_ADDR) == 0x0
	/* Use IMG_ADDR_PHYSICAL if d3-hardware.dtsi specifies 0 (typically GMSL) */
	#undef IMG_ADDR
	#define IMG_ADDR IMG_ADDR_PHYSICAL
#endif

#define SER_GPIO_NODE _SER_GPIO_NODE(PORT_IDX)
#define CAM_NODE _CAM_NODE(PORT_IDX)
#define SER_GPIO_EXP_NODE _SER_GPIO_EXP_NODE(PORT_IDX)

&CAM_NODE {
	compatible = "d3,isx031";
	status = "okay";

	physical-addr = <HEX_PREFIX(IMG_ADDR_PHYSICAL)>;
	reg = <HEX_PREFIX(IMG_ADDR)>;

	mclk = "extperiph1";
	physical_w = "4.66"; // 7.45mm diagonal
	physical_h = "5.81";
	sensor_model = "isx031";
	use_decibel_gain = "false";
	use_sensor_mode_id = "true";

	#ifdef FPDLINK
	reset-gpios = <&SER_GPIO_EXP_NODE 0 GPIO_ACTIVE_HIGH>;
	#else
	reset-gpios = <&SER_NODE 0 GPIO_ACTIVE_HIGH>;
	#endif

	#include "d3-cam-isx031-modes.dtsi"

	ports {
		status = "okay";
	};
};
